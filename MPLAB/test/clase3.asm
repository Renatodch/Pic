list p=16f88
#include  <p16f88.inc>
__CONFIG _CONFIG1,(_XT_OSC & _WDT_OFF & _PWRTE_OFF & _BODEN_OFF & _MCLR_OFF & _CCP1_RB0  & _CP_OFF & _CPD_OFF & _DEBUG_OFF & _LVP_OFF & _WRT_PROTECT_OFF) 
__CONFIG _CONFIG2,(_FCMEN_OFF & _IESO_OFF)

CBLOCK 0X20
X
TEMP_W
TEMP_STATUS
ENDC

ORG 0X00
GOTO INICIO
ORG 0X04
GOTO INTER
ORG 0X05

INICIO

BSF STATUS,RP0
BCF STATUS,RP1
CLRF ANSEL
MOVLW B'00000000'
MOVWF TRISA
MOVLW B'00000001'
MOVWF TRISB

BCF OPTION_REG,INTEDG
BCF OPTION_REG,T0CS
BCF OPTION_REG,PSA
BSF OPTION_REG,PS0
BCF OPTION_REG,PS1
BSF OPTION_REG,PS2

BCF STATUS,RP0
MOVLW B'00000000'
MOVWF PORTA
MOVLW B'00000000'
MOVWF PORTB

BSF INTCON,GIE
BSF INTCON,INT0IE
BSF INTCON,TMR0IE
BCF INTCON,TMR0IF
BCF INTCON,INT0IF

MOVLW .61
MOVWF TMR0

BCF PORTA,0
BCF PORTA,1
BCF PORTB,2

BUCLE
NOP
GOTO BUCLE


INTER
MOVFW TEMP_W
MOVWF STATUS
MOVWF TEMP_STATUS


BTFSS INTCON,TMR0IF
GOTO PREG1

 
BTFSS PORTA,0
GOTO $+2
GOTO $+9
BSF PORTA,0

BTFSS PORTA,1
GOTO $+2
GOTO $+3
BSF PORTA,1
GOTO $+4
BCF PORTA,1
GOTO $+2

BCF PORTA,0

MOVLW .61
MOVWF TMR0


PREG1
BTFSS INTCON,INT0IF
GOTO SALIR
BTFSS PORTB,2
GOTO $+2
GOTO $+3
BSF PORTB,2
GOTO SALIR
BCF PORTB,2
	

SALIR

BCF INTCON,INT0IF
BCF INTCON,TMR0IF

MOVFW TEMP_STATUS
MOVWF STATUS
MOVFW TEMP_W

RETFIE

END

