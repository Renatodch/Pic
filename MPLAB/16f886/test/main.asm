list p=16f886
#include <p16f886.inc>
#include <MACROS.inc>
__CONFIG _CONFIG1, _FOSC_XT & _WDTE_OFF & _PWRTE_OFF & _MCLRE_ON & _CP_OFF & _CPD_OFF & _BOREN_OFF & _IESO_OFF & _FCMEN_OFF & _LVP_OFF
__CONFIG _CONFIG2, _BOR4V_BOR40V & _WRT_OFF

CBLOCK 0X20
X,
TEMP_W,
TEMP_STATUS,

ENDC

ORG 0X00
GOTO INICIO
ORG 0X04
GOTO INTER
ORG 0X05

INICIO

LOAD TMR0, .61

BSF STATUS, RP0  ; bank 1 
LOAD TRISA, 0x00
LOAD TRISB, 0x01
LOAD INTCON,0xB0
LOAD OPTION_REG,B'00000111'

BSF STATUS,RP1; bank 4
CLRF ANSEL
CLRF ANSELH

BCF STATUS,RP1 
BCF STATUS,RP0 ; bank 0
LOAD PORTA, 0x00
LOAD PORTB, 0x00

BUCLE

Del .3
bsf PORTB,1

Del .3
bcf PORTB,1

GOTO BUCLE


INTER
MOVWF TEMP_W
MOVF STATUS,0
MOVWF TEMP_STATUS

BTFSS INTCON,T0IF
GOTO RB0_INT
GOTO TM0_INT

TM0_INT

LOAD TMR0,.61
GOTO EXIT_INT

RB0_INT
BTFSS INTCON,INTF
GOTO EXIT_INT
BTFSS PORTB,2
GOTO $+2
GOTO $+3
BSF PORTB,2
GOTO EXIT_INT
BCF PORTB,2
	

EXIT_INT

BCF INTCON,INTF
BCF INTCON,T0IF

MOVFW TEMP_STATUS
MOVWF STATUS
MOVFW TEMP_W
RETFIE


END

